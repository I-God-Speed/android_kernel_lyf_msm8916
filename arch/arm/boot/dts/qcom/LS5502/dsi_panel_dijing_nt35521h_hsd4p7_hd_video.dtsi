/* Copyright (c) 2020, The Linux Foundation. All rights reserved.
*  Copyright (c) 2020, the_shahnawaz_sheikh (sheikhshahnawaz41299).
*
* This program is free software; you can redistribute it and/or modify
* it under the terms of the GNU General Public License version 2 and
* only version 2 as published by the Free Software Foundation.
*
* This program is distributed in the hope that it will be useful,
* but WITHOUT ANY WARRANTY; without even the implied warranty of
* MERCHANTABILITY or FITNESS FOR A PARTICULAR PURPOSE.  See the
* GNU General Public License for more details.
*/

&mdss_mdp {
	nt35521_dijing_4p7inch_hd_vid: qcom,mdss_dijing_nt35521_4p7inch_video {
				qcom,mdss-dsi-panel-name = "nt35521_dijing_4p7inch_hd_video_panel";
				qcom,mdss-dsi-panel-code-version = "_20150720";
				qcom,mdss-dsi-panel-supply = <0x1>;
				qcom,mdss-dsi-panel-controller = <&mdss_dsi0>;
				qcom,mdss-dsi-panel-type = "dsi_video_mode";
				qcom,mdss-dsi-panel-destination = "display_1";
				qcom,mdss-dsi-panel-framerate = <60>;
				qcom,mdss-dsi-virtual-channel-id = <0>;
				qcom,mdss-dsi-stream = <0>;
				qcom,mdss-dsi-panel-width = <720>;
				qcom,mdss-dsi-panel-height = <1280>;
				qcom,mdss-dsi-h-front-porch = <60>;
				qcom,mdss-dsi-h-back-porch = <60>;
				qcom,mdss-dsi-h-pulse-width = <12>;
				qcom,mdss-dsi-h-sync-skew = <0>;
				qcom,mdss-dsi-v-front-porch = <16>;
				qcom,mdss-dsi-v-back-porch = <16>;
				qcom,mdss-dsi-v-pulse-width = <2>;
				qcom,mdss-dsi-h-left-border = <0>;
				qcom,mdss-dsi-h-right-border = <0>;
				qcom,mdss-dsi-v-top-border = <0>;
				qcom,mdss-dsi-v-bottom-border = <0>;
				qcom,mdss-dsi-bpp = <0x18>;
				qcom,mdss-dsi-color-order = <0x0>;
				qcom,mdss-dsi-underflow-color = <0xff>;
				qcom,mdss-dsi-border-color = <0x0>;
				qcom,mdss-dsi-pixel-packing = <0x0>;
				qcom,mdss-dsi-on-command = [39 01 00 00 00 00 06 f0 55 aa 52 08 00 39 01 00 00 00 00 05 ff aa 55 a5 80 39 01 00 00 00 00 03 6f 11 00 39 01 00 00 00 00 03 f7 20 00 39 01 00 00 00 00 02 6f 01 39 01 00 00 00 00 02 b1 21 39 01 00 00 00 00 02 c8 80 39 01 00 00 00 00 04 d9 00 01 4c 39 01 00 00 00 00 06 bd 01 a0 0c 08 01 39 01 00 00 00 00 02 6f 02 39 01 00 00 00 00 02 b8 0c 39 01 00 00 00 00 03 bb 11 11 39 01 00 00 00 00 03 bc 00 00 39 01 00 00 00 00 02 b6 01 39 01 00 00 00 00 06 f0 55 aa 52 08 01 39 01 00 00 00 00 03 b0 0a 0a 39 01 00 00 00 00 03 b1 0a 0a 39 01 00 00 00 00 03 bc a0 00 39 01 00 00 00 00 03 bd a0 00 39 01 00 00 00 00 02 ca 00 39 01 00 00 00 00 02 c0 04 39 01 00 00 00 00 03 b5 03 03 39 01 00 00 00 00 02 be 7a 39 01 00 00 00 00 03 b3 28 28 39 01 00 00 00 00 03 b4 1c 1c 39 01 00 00 00 00 03 b8 05 05 39 01 00 00 00 00 03 b9 36 36 39 01 00 00 00 00 03 ba 15 15 39 01 00 00 00 00 06 f0 55 aa 52 08 02 39 01 00 00 00 00 02 ee 01 39 01 00 00 00 00 11 b0 00 00 00 09 00 1d 00 32 00 41 00 61 00 7e 00 a7 39 01 00 00 00 00 11 b1 00 c8 01 01 01 33 01 84 01 c7 01 c9 02 06 02 4c 39 01 00 00 00 00 11 b2 02 73 02 ac 02 cd 03 01 03 1b 03 44 03 5f 03 78 39 01 00 00 00 00 05 b3 03 df 03 ff 39 01 00 00 00 00 02 6f 02 39 01 00 00 00 00 02 f7 47 39 01 00 00 00 00 02 6f 0a 39 01 00 00 00 00 02 f7 02 39 01 00 00 00 00 02 6f 17 39 01 00 00 00 00 02 f4 70 39 01 00 00 00 00 02 6f 11 39 01 00 00 00 00 02 f3 01 39 01 00 00 00 00 06 f0 55 aa 52 08 06 39 01 00 00 00 00 03 b0 2d 2e 39 01 00 00 00 00 03 b1 29 2a 39 01 00 00 00 00 03 b2 16 18 39 01 00 00 00 00 03 b3 10 12 39 01 00 00 00 00 03 b4 00 31 39 01 00 00 00 00 03 b5 31 31 39 01 00 00 00 00 03 b6 31 02 39 01 00 00 00 00 03 b7 31 31 39 01 00 00 00 00 03 b8 31 31 39 01 00 00 00 00 03 b9 31 31 39 01 00 00 00 00 03 ba 31 31 39 01 00 00 00 00 03 bb 31 31 39 01 00 00 00 00 03 bc 31 31 39 01 00 00 00 00 03 bd 03 31 39 01 00 00 00 00 03 be 31 31 39 01 00 00 00 00 03 bf 31 01 39 01 00 00 00 00 03 c0 13 11 39 01 00 00 00 00 03 c1 19 17 39 01 00 00 00 00 03 c2 2a 29 39 01 00 00 00 00 03 c3 2e 2d 39 01 00 00 00 00 03 e5 31 31 39 01 00 00 00 00 03 c4 2e 2d 39 01 00 00 00 00 03 c5 29 2a 39 01 00 00 00 00 03 c6 13 11 39 01 00 00 00 00 03 c7 19 17 39 01 00 00 00 00 03 c8 03 31 39 01 00 00 00 00 03 c9 31 31 39 01 00 00 00 00 03 ca 31 01 39 01 00 00 00 00 03 cb 31 31 39 01 00 00 00 00 03 cc 31 31 39 01 00 00 00 00 03 cd 31 31 39 01 00 00 00 00 03 ce 31 31 39 01 00 00 00 00 03 cf 31 31 39 01 00 00 00 00 03 d0 31 31 39 01 00 00 00 00 03 d1 00 31 39 01 00 00 00 00 03 d2 31 31 39 01 00 00 00 00 03 d3 31 02 39 01 00 00 00 00 03 d4 16 18 39 01 00 00 00 00 03 d5 10 12 39 01 00 00 00 00 03 d6 2a 29 39 01 00 00 00 00 03 d7 2d 2e 39 01 00 00 00 00 03 e6 31 31 39 01 00 00 00 00 06 d8 00 00 00 00 00 39 01 00 00 00 00 06 d9 00 00 00 00 00 39 01 00 00 00 00 02 e7 00 39 01 00 00 00 00 06 f0 55 aa 52 08 05 39 01 00 00 00 00 02 ed 30 39 01 00 00 00 00 06 f0 55 aa 52 08 03 39 01 00 00 00 00 03 b1 20 00 39 01 00 00 00 00 03 b0 20 00 39 01 00 00 00 00 06 f0 55 aa 52 08 05 39 01 00 00 00 00 02 e5 00 39 01 00 00 00 00 06 f0 55 aa 52 08 05 39 01 00 00 00 00 03 b0 17 06 39 01 00 00 00 00 02 b8 00 39 01 00 00 00 00 03 b1 17 06 39 01 00 00 00 00 03 b9 00 03 39 01 00 00 00 00 03 b2 17 06 39 01 00 00 00 00 03 ba 00 00 39 01 00 00 00 00 03 b3 17 06 39 01 00 00 00 00 03 bb 02 03 39 01 00 00 00 00 03 b4 17 06 39 01 00 00 00 00 03 b5 17 06 39 01 00 00 00 00 03 b6 17 06 39 01 00 00 00 00 03 b7 17 06 39 01 00 00 00 00 03 bc 02 03 39 01 00 00 00 00 02 e5 06 39 01 00 00 00 00 02 e6 06 39 01 00 00 00 00 02 e7 00 39 01 00 00 00 00 02 e8 06 39 01 00 00 00 00 02 e9 06 39 01 00 00 00 00 02 ea 06 39 01 00 00 00 00 02 eb 00 39 01 00 00 00 00 02 ec 00 39 01 00 00 00 00 06 f0 55 aa 52 08 05 39 01 00 00 00 00 02 c0 0a 39 01 00 00 00 00 02 c1 08 39 01 00 00 00 00 02 c2 a6 39 01 00 00 00 00 02 c3 05 39 01 00 00 00 00 06 f0 55 aa 52 08 03 39 01 00 00 00 00 06 b2 04 00 86 00 00 39 01 00 00 00 00 06 b3 04 00 86 00 00 39 01 00 00 00 00 06 b4 04 00 17 00 00 39 01 00 00 00 00 06 b5 04 00 17 00 00 39 01 00 00 00 00 06 f0 55 aa 52 08 05 39 01 00 00 00 00 02 c4 00 39 01 00 00 00 00 02 c5 02 39 01 00 00 00 00 02 c6 22 39 01 00 00 00 00 02 c7 03 39 01 00 00 00 00 06 f0 55 aa 52 08 03 39 01 00 00 00 00 06 b6 02 00 19 00 00 39 01 00 00 00 00 06 b7 02 00 19 00 00 39 01 00 00 00 00 06 b8 02 00 19 00 00 39 01 00 00 00 00 06 b9 02 00 19 00 00 39 01 00 00 00 00 06 f0 55 aa 52 08 05 39 01 00 00 00 00 03 c8 06 20 39 01 00 00 00 00 03 c9 02 20 39 01 00 00 00 00 03 ca 01 60 39 01 00 00 00 00 03 cb 01 60 39 01 00 00 00 00 06 f0 55 aa 52 08 03 39 01 00 00 00 00 06 ba 44 00 86 00 00 39 01 00 00 00 00 06 bb 44 00 86 00 00 39 01 00 00 00 00 06 bc 44 00 1a 00 00 39 01 00 00 00 00 06 bd 44 00 1a 00 00 39 01 00 00 00 00 06 f0 55 aa 52 08 05 39 01 00 00 00 00 06 d1 00 05 01 07 10 39 01 00 00 00 00 06 d2 10 05 05 03 10 39 01 00 00 00 00 06 d3 20 00 43 07 10 39 01 00 00 00 00 06 d4 30 00 43 07 10 39 01 00 00 00 00 06 f0 55 aa 52 08 05 39 01 00 00 00 00 08 d0 00 00 00 00 00 00 00 39 01 00 00 00 00 0c d5 00 00 00 00 00 00 00 00 00 00 00 39 01 00 00 00 00 0c d6 00 00 00 00 00 00 00 00 00 00 00 39 01 00 00 00 00 0c d7 00 00 00 00 00 00 00 00 00 00 00 39 01 00 00 00 00 06 d8 00 00 00 00 00 39 01 00 00 00 00 06 f0 55 aa 52 08 05 39 01 00 00 00 00 04 cc 00 00 3c 39 01 00 00 00 00 04 cd 00 00 3c 39 01 00 00 00 00 04 ce 00 00 3c 39 01 00 00 00 00 04 cf 00 00 3c 39 01 00 00 00 00 06 f0 55 aa 52 08 03 39 01 00 00 00 00 05 c0 00 34 00 00 39 01 00 00 00 00 05 c1 00 00 34 00 39 01 00 00 00 00 05 c2 00 00 34 00 39 01 00 00 00 00 05 c3 00 00 34 00 39 01 00 00 00 00 06 f0 55 aa 52 08 03 39 01 00 00 00 00 02 c4 60 39 01 00 00 00 00 02 c5 c0 39 01 00 00 00 00 02 c6 00 39 01 00 00 00 00 02 c7 00 39 01 00 00 00 00 02 6f 01 39 01 00 00 00 00 02 f9 46 39 01 00 00 00 00 06 f0 55 aa 52 08 00 05 01 00 00 78 00 02 11 00 05 01 00 00 14 00 02 29 00 15 01 00 00 01 00 02 53 2c];
				qcom,mdss-dsi-off-command = [15 01 00 00 01 00 02 53 24 05 01 00 00 14 00 02 28 00 05 01 00 00 78 00 02 10 00];
				qcom,mdss-dsi-on-command-state = "dsi_lp_mode";
				qcom,mdss-dsi-off-command-state = "dsi_lp_mode";
				qcom,mdss-dsi-lp11-init;
				qcom,mdss-dsi-h-sync-pulse = <1>;
				qcom,mdss-dsi-traffic-mode = <2>;
				qcom,mdss-dsi-lane-map = <0>;
				qcom,mdss-dsi-bllp-eof-power-mode;
				qcom,mdss-dsi-bllp-power-mode;
				qcom,mdss-dsi-lane-0-state;
				qcom,mdss-dsi-lane-1-state;
				qcom,mdss-dsi-lane-2-state;
				qcom,mdss-dsi-lane-3-state;
				qcom,mdss-dsi-panel-timings = <0x761a1000 0x3c3e141c 0x12030400>;
				qcom,mdss-dsi-t-clk-post = <0x4>;
				qcom,mdss-dsi-t-clk-pre = <0x19>;
				qcom,mdss-dsi-bl-min-level = <0x0>;
				qcom,mdss-dsi-bl-max-level = <0xff>;
				qcom,mdss-dsi-dma-trigger = <0x4>;
				qcom,mdss-dsi-mdp-trigger = <0x0>;
				qcom,mdss-pan-bl-levels = <0x1 0xff>;
				qcom,mdss-dsi-bl-pmic-control-type = "bl_ctrl_dcs";
				qcom,mdss-dsi-bl-pmic-bank-select = <0x3>;
				qcom,mdss-dsi-bl-pmic-pwm-frequency = <0x10e>;
				qcom,mdss-dsi-pwm-gpio = <&pm8916_mpps 6 0>;
				qcom,mdss-dsi-reset-sequence = <0x1 0xa 0x0 0xa 0x1 0x78>;
				qcom,cont-splash-enabled;
			};
};
