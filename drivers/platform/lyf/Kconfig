## drivers/platform/lyf/Kconfig
```kconfig
# Lyf configuration options

config MACH_LYF
	bool "Lyf device"
	depends on ARCH_MSM
	help
	  Support for Lyf products

config MACH_LYF_MSM8916
	bool "Lyf MSM8916"
	depends on ARCH_MSM8916
	select MACH_LYF
	help
	  Support for MSM8916 Lyf variants

menu "Lyf board selection"

config MACH_LS5502
	bool "LS5502 board"
	select MACH_LYF_MSM8916
	help
	  Support for Lyf wind 3 variant

endmenu
```
